## sdkconfig.defaults
```kconfig
# Hydra 64HD BLE Controller defaults
CONFIG_BT_ENABLED=y
CONFIG_BT_NIMBLE_ENABLED=y
CONFIG_BT_BLE_ENABLED=y
CONFIG_NVS_FLASH=y
CONFIG_ESP_HTTP_SERVER_ENABLE=y
CONFIG_MQTT_PROTOCOL_311=y
CONFIG_FREERTOS_USE_TRACE_FACILITY=y
CONFIG_LOG_DEFAULT_LEVEL_INFO=y
```
